## CMakeLists.txt
```
cmake_minimum_required(VERSION 3.20.0)

find_package(Zephyr REQUIRED HINTS $ENV{ZEPHYR_BASE})

project(BLE_BEACON)

target_sources(app PRIVATE src/main.c)
```

## prj.conf
```kconfig
# Enable DevKit library to access gpio
CONFIG_DK_LIBRARY=y

# Include BLE Stack
CONFIG_BT=y

# Set BLE device name
CONFIG_BT_DEVICE_NAME="Nordic_Beacon"

# Enable LOG Module
CONFIG_LOG=y
```

## src/main.c
```c
#include <zephyr/kernel.h>
#include <zephyr/logging/log.h>
#include <zephyr/bluetooth/bluetooth.h>
#include <zephyr/bluetooth/gap.h>
#include <dk_buttons_and_leds.h>

// Declare the Company identifier (Company ID). In this exercise: Nordic Semiconductor Company ID
#define COMPANY_ID_CODE 0x0059
// Declare the structure for our custom data to advertise
struct adv_mfg_data_type
{
        uint16_t company_code;
        uint16_t number_press;
};

#define USER_BUTTON DK_BTN1_MSK

// Create an LE Advertising Parameters variable
static struct bt_le_adv_param *adv_param = BT_LE_ADV_PARAM(BT_LE_ADV_OPT_NONE, 800, 801, NULL);

// Define and initialize a variable of type adv_mfg_data_type
static struct adv_mfg_data_type adv_mfg_data = {COMPANY_ID_CODE, 0x00};

// Declare the URL data to include in the scan response
// 0x17 means 'https:' based on URI scheme name string mapping from Bluetooth SIG
static unsigned char url_data[] = {0x17, '/', '/', 'a', 'c', 'a', 'd', 'e', 'm',
                                   'y', '.', 'n', 'o', 'r', 'd', 'i', 'c', 's',
                                   'e', 'm', 'i', '.', 'c', 'o', 'm'};

LOG_MODULE_REGISTER(Lesson2_Exercise2, LOG_LEVEL_INF);

#define DEVICE_NAME CONFIG_BT_DEVICE_NAME
#define DEVICE_NAME_LEN (sizeof(DEVICE_NAME) - 1)

#define RUN_STATUS_LED DK_LED1
#define RUN_LED_BLINK_INTERVAL 1000

static const struct bt_data ad[] = {
    BT_DATA_BYTES(BT_DATA_FLAGS, BT_LE_AD_NO_BREDR),
    BT_DATA(BT_DATA_NAME_COMPLETE, DEVICE_NAME, DEVICE_NAME_LEN),
    // Include the Manufacturer Specific Data in the advertising packet
    BT_DATA(BT_DATA_MANUFACTURER_DATA, (unsigned char *)&adv_mfg_data, sizeof(adv_mfg_data)),
};

static const struct bt_data sd[] = {
    BT_DATA(BT_DATA_URI, url_data, sizeof(url_data)),
};

// Add the definition of callback function and update the advertising data dynamically
static void button_changed(uint32_t button_state, uint32_t has_changed)
{
        if (has_changed & button_state & USER_BUTTON)
        {
                adv_mfg_data.number_press += 1;
                bt_le_adv_update_data(ad, ARRAY_SIZE(ad),
                                      sd, ARRAY_SIZE(sd));
        }
}
// Define the initialization function of the buttons and setup interrupt.
static int init_button(void)
{
        int err;

        err = dk_buttons_init(button_changed);
        if (err)
        {
                printk("Cannot init buttons (err: %d)\n", err);
        }

        return err;
}

void main(void)
{
        int blink_status = 0;
        int err;

        LOG_INF("Starting Lesson 2 - Exercise 2 \n");

        err = dk_leds_init();
        if (err)
        {
                LOG_ERR("LEDs init failed (err %d)\n", err);
                return;
        }

        // Setup buttons on your board
        err = init_button();
        if (err)
        {
                printk("Button init failed (err %d)\n", err);
                return;
        }

        // Start BLE
        err = bt_enable(NULL);
        if (err)
        {
                LOG_ERR("Bluetooth init failed (err %d)\n", err);
                return;
        }

        LOG_INF("Bluetooth initialized\n");

        // Start BLE Advertise
        err = bt_le_adv_start(adv_param, ad, ARRAY_SIZE(ad), sd, ARRAY_SIZE(sd));
        if (err)
        {
                LOG_ERR("Advertising failed to start (err %d)\n", err);
                return;
        }

        LOG_INF("Advertising successfully started\n");

        for (;;)
        {
                dk_set_led(RUN_STATUS_LED, (++blink_status) % 2);
                k_sleep(K_MSEC(RUN_LED_BLINK_INTERVAL));
        }
}
```
